## components/lora_driver/Kconfig
```kconfig
menu "LoRa Drive Configuration"

config LORA_DEBUG
    bool "Enable LoRa SPI debug logging"
    default n
    help
        Enable debug logging for LoRa SPI transactions
        (TX/RX bytes). Useful during development and testing.

endmenu
```
